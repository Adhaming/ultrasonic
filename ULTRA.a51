//DECLARATION SOME DIRRECTIVES
ECHO EQU P3.0   //THE PIN OF ULTASONIC MAKE TIMER COUNT ===> INPUT PIN
TRIG EQU P3.1   // THE PIN OF ULTRASONIC MAKE IT START TRANSIMIT ====> OUTPUT PIN  
RS EQU P2.0     //REGISTER SELECT PIN OF LCD
E EQU P2.2      //ENABLE PIN OF LCD

LCD_LINE EQU P1  //PORT SEND DATA OR COMMAND TO LCD 
	
ORG 0H
SETB ECHO  ;CONFIGURE  AS INPUT PIN 
CLR TRIG   ;CONFIGURE  AS OUTPUT PIN
MOV TMOD,#00000010B;CONFIGURE TIMER0 IN MODE 2 AUTORELOAD
MOV TH0,#202       ;LOAD TH0 WITH 202 DECIMAL OR CA HEXA


ACALL LCD_START_UP  ;THE VALUES OF COMMAND  WILL INITAILZE LCD
MOV DPTR, #WE      ;PRINT "DISTANCE MEASURE"
ACALL MESSAGE
MOV A, #0C5H       ;TO MAKE CURSUR IM MID OF LINE 2
ACALL LCD_CMD
MOV DPTR, #WELCOME
ACALL MESSAGE
ACALL WAITING 
ACALL WAITING
ACALL CLEAR 
MOV DPTR,#DISTANC
ACALL MESSAGE
AGAIN: 
		ACALL CALCULATE_DISTANCE
		ACALL SEPARATE
		ACALL HEXA2ASCCII
		ACALL CURSUR_HOME
		ACALL PRINT
SJMP AGAIN

CALCULATE_DISTANCE:
			CLR A
			SETB TRIG
			ACALL DELAY_10uS
			CLR TRIG 
			
		W1: JNB ECHO,W1
			SETB TR0
			
		W2: JNB TF0,W2
			INC A
			CLR TF0
			JZ SKIP
			JB ECHO,W2
			CLR TR0
			
SKIP:
RET
SEPARATE: 
	SUBB A,#5
	MOV B,#10
	DIV AB
	MOV 41H,B
	MOV B,#10
	DIV AB
	MOV 42H,B
	MOV 43H,A
	RET

HEXA2ASCCII:
	MOV A,41H
	ADD A,#30H
	MOV 41H,A
	MOV A,42H
	ADD A,#30H
	MOV 42H,A
	MOV A,43H
	ADD A,#30H
	MOV 43H,A
	RET
PRINT:
	MOV A,#' '
	ACALL LCD_DATA
	MOV A,43H
	ACALL LCD_DATA
	MOV A,42H
	ACALL LCD_DATA
	MOV A,41H
	ACALL LCD_DATA
	MOV A,#'c'
	ACALL LCD_DATA
	MOV A,#'m'
	ACALL LCD_DATA
RET
CURSUR_HOME:
	MOV A,#86H
	ACALL LCD_CMD
	MOV A,#0CH
	ACALL LCD_CMD
RET
DELAY_10uS:
	MOV R3,18
	H1MS: DJNZ R3,H1MS
RET
// **************************CONFIGRATION LCD********************************
LCD_START_UP:
   MOV A, #38H      ;INTIALIZE MATRIX 
   ACALL LCD_CMD
   MOV A, #0CH    ;DISPLAY ON ,CURSUR OFF
   ACALL LCD_CMD
   MOV A, #01H    ;CLEAR LCD
   ACALL LCD_CMD
   MOV A, #06H    ;ENTRY MODE
   ACALL LCD_CMD
   MOV A, #80H    ;STARTE AT LINE 1
   ACALL LCD_CMD
RET
LCD_CMD:
   MOV LCD_LINE, A
   CLR RS   ;BECAUSE IT IS COMMAND
   ;ACTIVE ENABLE HIGH TO LW
   SETB E   
   ACALL SDELAY
   CLR E
   ACALL LDELAY
RET
LCD_DATA:
   MOV LCD_LINE, A
   SETB RS  ;BECAUSE IT IS DATA
   SETB E
   ACALL SDELAY
   CLR E
   ACALL LDELAY
RET

//WAIT DELAY 666ms
WAITING:
   MOV R6, #12
   WAIT2: ACALL LDELAY
   DJNZ R6, WAIT2
RET

; LONG DELAY IS ABPUT 55ms
LDELAY:
   MOV R0, #50
   G1: MOV R1, #255
   G2: DJNZ R1, G2
       DJNZ R0, G1
RET
;SHORT DELAY ABOUT 1ms
SDELAY:
   MOV R0, #55
   H1: MOV R1, #7
   H2: DJNZ R1, H2
   DJNZ R0, H1
RET
MESSAGE: 
A2:    MOV A, #0
	   MOVC A, @A+DPTR
	   JZ FINISH
	   ACALL LCD_DATA
	   INC DPTR
	   SJMP A2
FINISH: RET
CLEAR: 
	   MOV A, #02H    ;RETURN HOME 
	   ACALL LCD_CMD
	   MOV A, #01H    ;CLEAR LCD 
	   ACALL LCD_CMD
	   MOV A, #80H    ;LINE ONE FIRST DIGIT 
	   ACALL LCD_CMD
	   MOV A, #0FH    ;DISPLAY ON CURSURE BILINKING 
	   ACALL LCD_CMD
RET

//***********************************ROM STORAGE****************************************** 
WE: DB "DISTANCE MEASURE", 00H
WELCOME: DB "WELCOME", 00H
	DISTANC: DB "DIS:  ",00H 
	
END